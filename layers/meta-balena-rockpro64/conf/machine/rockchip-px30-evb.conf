## layers/meta-balena-rockpro64/conf/machine/rockchip-px30-evb.conf
```bitbake
#@TYPE: Machine
#@NAME: PX30 EVB


SOC_FAMILY = "rk3399"

RK_ISP_VERSION := "1"

require conf/machine/include/soc-family.inc
require conf/machine/include/arm/arch-armv8a.inc

# require conf/machine/include/px30.inc

SERIAL_CONSOLES = "1500000;ttyFIQ0"
KERNEL_IMAGETYPE = "Image.gz"
KBUILD_DEFCONFIG = "rockchip_linux_defconfig"
KERNEL_DEVICETREE = "rockchip/px30-evb-ddr3-v10-linux.dtb"
UBOOT_MACHINE = "evb-px30_defconfig"


# RK_WIFIBT_FIRMWARES = " \
# 	rkwifibt-firmware-ap6212a1-wifi \
# 	rkwifibt-firmware-ap6212a1-bt \
# 	brcm-tools \
# "

PREFERRED_PROVIDER_virtual/bootloader = "u-boot"
PREFERRED_PROVIDER_virtual/kernel = "linux-rockchip"
PREFERRED_VERSION_linux-rockchip = "4.4"


MACHINE_ESSENTIAL_EXTRA_RDEPENDS += "kernel-devicetree"
```
